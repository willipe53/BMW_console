#include <Preferences.h>
#include <ESP32Servo.h>
#include "esp_adc_cal.h"

Preferences prefs;
Servo fuelServo;
Servo tempServo;
Servo servoMotor[] = {fuelServo, tempServo};

//                   FUEL TEMP
//                   ---- ----
int servoPins[]   = {  A0,   A1};  //to gauges
int oldMSVal[]    = {   1,    1};  //store last MS value for each servo
int sensorPins[]  = {  A4,   A3};  //from senders
int R1ohms[]      = { 100,  470};  //for voltage dividers
int granularity[] = {  10,   10};  //for ignoring small changes
int gaugeMax[]    = {2100, 2000};  //top of gauges in MS
int gaugeMin[]    = {1400, 1200};  //bottom of gauges in MS
int sensorMax[]   = {  80,  550};  //max ohms generated by senders

bool sensorsOn = true;
String inputChars = "abcdefghijklmpx";
String outputNames[] = {"Set fuel level (0-80 ohms)",              //a
                        "Set water temp (0-550 ohms)",             //b
                        "Set fuel level (1000-2000 MS)",           //c
                        "Set water temp (1000-2000 MS)",           //d
                        "Set fuel granularity (move gauge less)",  //e 
                        "Set water granularity (move gauge less)", //f
                        "Set fuel sensor max output (mfg spec)",   //g
                        "Set water sensor max output (mfg spec)",  //h
                        "Set fuel gauge top value MS",             //i
                        "Set water gauge top value MS",            //j
                        "Set fuel gauge bottom value MS",          //k
                        "Set water gauge bottom value MS",         //l
                        "Turn on/off sensors",                     //m
                        "Print all values",                        //p
                        "Purge all saved values"};                 //x

void setup() {
  Serial.begin(115200);
  ESP32PWM::allocateTimer(0);
  ESP32PWM::allocateTimer(1);
  for (int i=0; i<2; i++) {
    servoMotor[i].setPeriodHertz(50); 
    //servoMotor[i].attach(servoPins[i]);    
  }
  setServo(0, sensorMax[0], false); //fuel reads high resistance when empty  
  setServo(1, 0, false);            //temp reads zero resistance when cold
  loadPreferences(true);
  delay(500);
  printValues();
}

void writePreference(String key, int valu) {
  prefs.begin("gauges");
  prefs.putInt(key.c_str(), valu);
  prefs.end();
  loadPreferences(true);
}

void loadPreferences(bool prefsExist) {
  prefs.begin("gauges");
  if (prefs.getInt("f") == 0) {
    Serial.printf("Detected 0 for water granularity...\n");
    prefsExist = false;
  }
  if (!prefsExist) writeDefaults();
  granularity[0] = prefs.getInt("e");
  granularity[1] = prefs.getInt("f");
  sensorMax[0]   = prefs.getInt("g");
  sensorMax[1]   = prefs.getInt("h");
  gaugeMax[0]    = prefs.getInt("i");
  gaugeMax[1]    = prefs.getInt("j");
  gaugeMin[0]    = prefs.getInt("k");
  gaugeMin[1]    = prefs.getInt("l");
  prefs.end();
}

void writeDefaults() {
  Serial.printf("Rewriting default values\n");
  prefs.clear();
  prefs.putInt("e", granularity[0]);
  prefs.putInt("f", granularity[1]);
  prefs.putInt("g", sensorMax[0]);
  prefs.putInt("h", sensorMax[1]);
  prefs.putInt("i", gaugeMax[0]);
  prefs.putInt("j", gaugeMax[1]);
  prefs.putInt("k", gaugeMin[0]);
  prefs.putInt("l", gaugeMin[1]);
}

void toggleSensors() {
  sensorsOn = !sensorsOn;
  Serial.printf("Sensors set to %d\n", sensorsOn);  
}

void printValues() {
  Serial.printf("Available serial commands:\n");  
  for (int i=0; i<inputChars.length(); i++) {    
    String key = inputChars.substring(i,i+1);
    Serial.printf("  %s - %s (now %d)\n", key.c_str(), outputNames[i].c_str(), getValue(key));  
  }  
}

int getValue(String key) {
  if (key.equals("a"))      return ohmVal(oldMSVal[0], 0); //Fuel ohms - a
  else if (key.equals("b")) return ohmVal(oldMSVal[1], 1); //Water ohms - b
  else if (key.equals("c")) return oldMSVal[0];            //Fuel level MS - c
  else if (key.equals("d")) return oldMSVal[1];            //Water temp MS - d
  else if (key.equals("e")) return granularity[0];         //Fuel granul - e 
  else if (key.equals("f")) return granularity[1];         //Water granul - f
  else if (key.equals("g")) return sensorMax[0];           //Fuel sensor max - g
  else if (key.equals("h")) return sensorMax[1];           //Water sensor max - h
  else if (key.equals("i")) return gaugeMax[0];            //Fuel gauge top MS - i
  else if (key.equals("j")) return gaugeMax[1];            //Water gauge top MS - j
  else if (key.equals("k")) return gaugeMin[0];            //Fuel gauge bot MS - k
  else if (key.equals("l")) return gaugeMin[1];            //Water gauge bot MS - l
  else if (key.equals("m")) return sensorsOn;              //Sensors on/off - m
  else return -1;  
}

int ohmVal(int MSVal, int idx) {
  float MSrange = gaugeMax[idx] - gaugeMin[idx];
  float oneMS = (float)sensorMax[idx] / MSrange;
  float spot = MSVal - gaugeMin[idx];
  float ohms = spot * oneMS;
  //Serial.printf("     >>>MSVal:%d mx:%d mn:%d msrange:%f ohmrange:%f oneMS:%f spot:%f ohms:%f\n", 
  //              MSVal, gaugeMax[idx], gaugeMin[idx], MSrange, (float)sensorMax[idx], oneMS, spot, ohms);  
  return (int)ohms;
}

int msVal(int ohmVal, int idx) {
  float MSrange = gaugeMax[idx] - gaugeMin[idx];
  float oneOhm = MSrange / (float)sensorMax[idx];
  float spot = ohmVal * oneOhm;
  float MS = gaugeMin[idx] + spot;
  //Serial.printf("     >>>OhmVal:%d mx:%d mn:%d msrange:%f ohmrange:%f oneOhm:%f spot:%f MS:%f\n", 
  //              ohmVal, gaugeMax[idx], gaugeMin[idx], MSrange, (float)sensorMax[idx], oneOhm, spot, MS);  
  return (int)MS;  
}

int pctVal(int ohmVal, int idx) {
  float pct = ((float)ohmVal / (float)sensorMax[idx]) * 100;
  if (idx == 0) pct = 100 - pct;
  return (int)pct;    
}

void setServo(int idx, int valu, bool isMS) {
  int MS = valu;
  int ohms = ohmVal(valu, idx);
  if (!isMS) {
    MS = msVal(valu, idx);
    ohms = valu;
  }
  if (MS > gaugeMax[idx]) MS = gaugeMax[idx];
  if (MS < gaugeMin[idx]) MS = gaugeMin[idx];
  if (oldMSVal[idx] == MS) return;
  servoMotor[idx].attach(servoPins[idx]);    
  servoMotor[idx].writeMicroseconds(MS);  
  oldMSVal[idx] = MS; 
  delay(500);
  int currMS = servoMotor[idx].readMicroseconds();
  servoMotor[idx].detach();    
  Serial.printf("Requested %d ohms (%dms) Servo reading %dms (%d percent)\n", ohms, MS, currMS, pctVal(ohms, idx));
}

int calculateResistance(int raw, int R1, int granularity) {
  float V1 = (readADC_Cal(raw))/1000.0;
  float R2 = (float)R1 / ((3.3/V1)-1.0);
  return (int)R2 - ((int)R2 % granularity);
}

uint32_t readADC_Cal(int ADC_Raw) {
  esp_adc_cal_characteristics_t adc_chars;
  esp_adc_cal_characterize(ADC_UNIT_1, ADC_ATTEN_DB_11, ADC_WIDTH_BIT_12, 1100, &adc_chars);
  return(esp_adc_cal_raw_to_voltage(ADC_Raw, &adc_chars));
}

void loop() {
  //read sensor input values
  if (sensorsOn) {
    for (int i=0; i<2; i++) { 
      int raw = analogRead(sensorPins[i]);
      int R2 = calculateResistance(raw, R1ohms[i], granularity[i]);
      setServo(i, R2, false);
      delay(1000);
    }
  }
  
 //manual testing
  if (Serial.available() > 0) {
    String inp = Serial.readString();
    String key = inp.substring(0,1);
    int valu = inp.substring(1,inp.length()-1).toInt();
    if (key.equals("a"))      setServo(0, valu, false);   //Fuel ohms - a
    else if (key.equals("b")) setServo(1, valu, false);   //Water ohms - b
    else if (key.equals("c")) setServo(0, valu, true);    //Fuel level MS - c
    else if (key.equals("d")) setServo(1, valu, true);    //Water temp MS - d
    else if (key.equals("e")) writePreference(key, valu); //Fuel granul - e 
    else if (key.equals("f")) writePreference(key, valu); //Water granul - f
    else if (key.equals("g")) writePreference(key, valu); //Fuel sensor max - g
    else if (key.equals("h")) writePreference(key, valu); //Water sensor max - h
    else if (key.equals("i")) writePreference(key, valu); //Fuel gauge top MS - i
    else if (key.equals("j")) writePreference(key, valu); //Water gauge top MS - j
    else if (key.equals("k")) writePreference(key, valu); //Fuel gauge bot MS - k
    else if (key.equals("l")) writePreference(key, valu); //Water gauge bot MS - l
    else if (key.equals("m")) toggleSensors();            //Sensors on/off - m
    else if (key.equals("p")) printValues();              //Print values - p
    else if (key.equals("x")) loadPreferences(false);     //Wipe prefs - x
    else Serial.printf("Unrecognized input: no values will be changed\n");
  }  
}
